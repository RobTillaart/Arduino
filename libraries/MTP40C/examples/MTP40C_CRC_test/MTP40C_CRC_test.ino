//
//    FILE: MTP40C_CRC_test.ino
//  AUTHOR: Rob Tillaart
// PURPOSE: compare CRC datasheet vs MODBUS
//     URL: https://github.com/RobTillaart/MTP40C
//
//  formula is faster than lookup on AVR (UNO) but not on ESP32
//  therefore in the library depending on platform a different
//  CRC algorithm is used. 

uint32_t start, count = 0, duration1 = 0, duration2 = 0;

void setup()
{
  Serial.begin(115200);
  Serial.println(__FILE__);
  delay(100);
}


void loop()
{
  uint8_t arr[50];
  uint8_t len = random(50);
  for (int i = 0; i < len; i++) arr[i] = random(256);

  start = micros();
  uint16_t crc1 = CRC_DATASHEET(arr, len);
  duration1 += micros() - start;
  start = micros();
  uint16_t crc2 = CRC_MODBUS(arr, len);
  duration2 += micros() - start;

  if ((crc1 != crc2) || (++count % 100 == 0))
  {
    Serial.print(count);
    Serial.print("\t");
    Serial.print(len);
    Serial.print("\t");
    Serial.print(crc1, HEX);
    Serial.print("\t");
    Serial.print(crc2, HEX);
    Serial.print("\t");
    Serial.print(crc1 == crc2);
    Serial.print("\t");
    Serial.print(duration1);
    Serial.print("\t");
    Serial.print(duration2);
    Serial.print("\t");
    Serial.print((100.0 * duration1) / duration2);
    Serial.println();
    delay(100);
  }
}



//  from datasheet
uint16_t CRC_DATASHEET(uint8_t *data, uint16_t len)
{
  //  auchCRCHi contains 2 repeating patterns
  //  0x00, 0xC1, 0x81, 0x40
  //  0x01, 0xC0, 0x80, 0x41
  //  check CRC lib MODBUS polynome (slower and smaller).
  const uint8_t auchCRCHi[] = {
    0x00, 0xC1, 0x81, 0x40, 0x01, 0xC0, 0x80, 0x41, 0x01, 0xC0, 0x80, 0x41, 0x00, 0xC1, 0x81,
    0x40, 0x01, 0xC0, 0x80, 0x41, 0x00, 0xC1, 0x81, 0x40, 0x00, 0xC1, 0x81, 0x40, 0x01, 0xC0,
    0x80, 0x41, 0x01, 0xC0, 0x80, 0x41, 0x00, 0xC1, 0x81, 0x40, 0x00, 0xC1, 0x81, 0x40, 0x01,
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    0x00, 0xC1, 0x81, 0x40, 0x01, 0xC0, 0x80, 0x41, 0x01, 0xC0, 0x80, 0x41, 0x00, 0xC1, 0x81,
    0x40
  };


  const uint8_t auchCRCLo[] = {
    0x00, 0xC0, 0xC1, 0x01, 0xC3, 0x03, 0x02, 0xC2, 0xC6, 0x06, 0x07, 0xC7, 0x05, 0xC5, 0xC4,
    0x04, 0xCC, 0x0C, 0x0D, 0xCD, 0x0F, 0xCF, 0xCE, 0x0E, 0x0A, 0xCA, 0xCB, 0x0B, 0xC9, 0x09,
    0x08, 0xC8, 0xD8, 0x18, 0x19, 0xD9, 0x1B, 0xDB, 0xDA, 0x1A, 0x1E, 0xDE, 0xDF, 0x1F, 0xDD,
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    0x44, 0x84, 0x85, 0x45, 0x87, 0x47, 0x46, 0x86, 0x82, 0x42, 0x43, 0x83, 0x41, 0x81, 0x80,
    0x40
  };

  uint8_t  uchCRCHi = 0xFF ; // High byte initialization of the CRC
  uint8_t  uchCRCLo = 0xFF ; // The low byte of the CRC is initialized
  uint16_t uIndex;           // Query the CRC table index
  uint16_t crc;

  while (len--)               //  Complete the entire message buffer
  {
    uIndex   = uchCRCLo ^ *data++;            //  Calculate CRC
    uchCRCLo = uchCRCHi ^ auchCRCHi[uIndex];
    uchCRCHi = auchCRCLo[uIndex];
  }
  crc = (uint16_t)uchCRCHi * 256;
  crc += (uint16_t)uchCRCLo;
  return crc;
}


//  derived from https://github.com/RobTillaart/CRC 0.3.3
uint16_t CRC_MODBUS(uint8_t *array, uint16_t length)
{
  //    parameters           MODBUS
  const uint16_t polynome  = 0x8005;
  const uint16_t startmask = 0xFFFF;
  const uint16_t endmask   = 0x0000;
  const bool reverseIn     = true;
  const bool reverseOut    = true;

  //  start
  uint16_t crc = startmask;
  while (length--)
  {
    if ((length & 0xFF) == 0) yield();  // RTOS

    uint8_t data = *array++;
    if (reverseIn) data = reverse8(data);
    crc ^= ((uint16_t)data) << 8;
    for (uint8_t i = 8; i; i--)
    {
      if (crc & (1 << 15))
      {
        crc <<= 1;
        crc ^= polynome;
      }
      else
      {
        crc <<= 1;
      }
    }
  }
  if (reverseOut) crc = reverse16(crc);
  crc ^= endmask;
  return crc;
}

uint8_t reverse8(uint8_t in)
{
  uint8_t x = in;
  x = (((x & 0xAA) >> 1) | ((x & 0x55) << 1));
  x = (((x & 0xCC) >> 2) | ((x & 0x33) << 2));
  x =          ((x >> 4) | (x << 4));
  return x;
}

uint16_t reverse16(uint16_t in)
{
  uint16_t x = in;
  x = (((x & 0XAAAA) >> 1) | ((x & 0X5555) << 1));
  x = (((x & 0xCCCC) >> 2) | ((x & 0X3333) << 2));
  x = (((x & 0xF0F0) >> 4) | ((x & 0X0F0F) << 4));
  x = (( x >> 8) | (x << 8));
  return x;
}


// -- END OF FILE --
